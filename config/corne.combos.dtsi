#include <zmk-helpers/helper.h>
// #include "keymap.layout.h"

// #define DEF 0

/*                         KEY POSITIONS
  ╭─────────────────────────╮         ╭─────────────────────────╮
  │ --0 --1 --2 --3 --4 --5 │         │ --6 --7 --8 --9 -10 -11 │
  │ -12 -13 -14 -15 -16 -17 │         │ -18 -19 -20 -21 -22 -23 │
  │ -24 -25 -26 -27 -28 -29 ╰───╮ ╭───╯ -30 -31 -32 -33 -34 -35 │
  ╰───────────────╮ -36 -37 -38 │ │ -39 -40 -41 ╭───────────────╯
                  ╰─────────────╯ ╰─────────────╯ */

// äÄ (fast)
ZMK_LEADER_SEQUENCE_4(altgrASpace,      <&uc 00E4>, <41 13 39>,    <0>)
ZMK_LEADER_SEQUENCE_4(altgrShiftASpace, <&uc 00C4>, <41 38 13 39>, <0>)

// áÁ
ZMK_LEADER_SEQUENCE_4(altgrAQ,      <&uc 00E1>, <41 13 1>,    <0>)
ZMK_LEADER_SEQUENCE_4(altgrShiftAQ, <&uc 00C1>, <41 13 13 1>, <0>)

// àÀ
// ZMK_LEADER_SEQUENCE_4(altgrAW,      <&uc 00E0>, <41 13 2>,    <0>)
// ZMK_LEADER_SEQUENCE_4(altgrShiftAW, <&uc 00C0>, <41 13 13 2>, <0>)

// äÄ
// ZMK_LEADER_SEQUENCE_4(altgrAF,      &uc 00E4, RALT A F,       DEF)
// ZMK_LEADER_SEQUENCE_4(altgrShiftAF, &uc 00C4, RALT LSHFT A F, DEF)

// ßẞ (fast)
// ZMK_LEADER_SEQUENCE_4(altgrSSpace,      &uc 00DF, RALT S SPACE,       DEF)
// ZMK_LEADER_SEQUENCE_4(altgrShiftSSpace, &uc 1E9E, RALT LSHFT S SPACE, DEF)

// ßẞ
// ZMK_LEADER_SEQUENCE_4(altgrSQ,      &uc 00DF, RALT S Q,       DEF)
// ZMK_LEADER_SEQUENCE_4(altgrShiftSQ, &uc 1E9E, RALT LSHFT S Q, DEF)


// Deprecated ( OLD ), do not use...
// ZMK_COMBO(altgr_a_space,       &uc 00E4, RALT A SPACE,  DEF, COMBO_TERM_SHORT, COMBO_IDLE)
// ZMK_COMBO(altgr_shift_a_space, &uc 00C4, RALTL A SPACE, DEF, COMBO_TERM_LONG,  COMBO_IDLE)
//
// ZMK_COMBO(altgr_a_q,           &uc 00E4, RALT A Q,      DEF, COMBO_TERM_SHORT, COMBO_IDLE)
// ZMK_COMBO(altgr_shift_a_q,     &uc 00E4, RALTL A Q,     DEF, COMBO_TERM_LONG,  COMBO_IDLE)
//
// ZMK_COMBO(altgr_a_w,           &uc 00E4, RALT A W,      DEF, COMBO_TERM_SHORT, COMBO_IDLE)
// ZMK_COMBO(altgr_shift_a_w,     &uc 00E4, RALTL A W,     DEF, COMBO_TERM_LONG,  COMBO_IDLE)
//
// ZMK_COMBO(altgr_a_f,           &uc 00E4, RALT A F,      DEF, COMBO_TERM_SHORT, COMBO_IDLE)
// ZMK_COMBO(altgr_shift_a_f,     &uc 00E4, RALTL A F,     DEF, COMBO_TERM_LONG,  COMBO_IDLE)
